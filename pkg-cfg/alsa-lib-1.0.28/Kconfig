## pkg-cfg/alsa-lib-1.0.28/Kconfig
```kconfig
config BLD_ALSA_LIB_1p0p28
	bool
	default n
	prompt "Build alsa-lib-1.0.28"
	---help---
	  Select this option to cross-build the ALSA (Advanced Linux Sound
	  Architecture) library.
```

## pkg-cfg/alsa-utils-1.0.28/Kconfig
```kconfig
config BLD_ALSA_UTILS_1p0p28
	bool
	default n
	prompt "Build alsa-utils-1.0.28"
	---help---
	  Select this option to cross-build the ALSA (Advanced Linux Sound
	  Architecture) utilities.
```

## pkg-cfg/bash-4.2/Kconfig
```kconfig
config BLD_BASH_4p2
	bool
	default y
	prompt "Build bash-4.2"
	---help---
	  Select this option to cross-build bash, the Bourne-Again SHell.
```

## pkg-cfg/binutils-2.23/Kconfig
```kconfig
config BLD_BINUTILS_2p23
	bool
	default n
	prompt "Build binutils-2.23"
	---help---
	  Select this option to cross-build binutils; this is a linker, an
	  assembler, and other tools for handling object files.
```

## pkg-cfg/busybox-1.22.1/Kconfig
```kconfig
config BLD_BUSYBOX_1p22p1
	bool
	default y
	prompt "Build busybox-1.22.1"
	---help---
	  Crosslinux systems use BusyBox.  You can't fly without.

config FORCE_BUSYBOX
	def_bool y
	select BLD_BUSYBOX_1p22p1

config BUSYBOX_HAS_LOSETUP
	bool
	default y if ! HAVE_UTIL_LINUX
	default n if HAVE_UTIL_LINUX = y
```

## pkg-cfg/calc-2.12.4.13/Kconfig
```kconfig
config BLD_CALC_2p12p4p13
	bool
	default n
	prompt "Build calc-2.12.4.13"
	---help---
	  Select this option to cross-build calc, a C-style arbitrary precision
	  calculator.
```

## pkg-cfg/cloog-0.16.1/Kconfig
```kconfig
config BLD_CLOOG_0p16p1
	bool
	default n
	prompt "Build cloog-0.16.1"
	---help---
	  Select this option to cross-build cloog, a support library mainly for
	  gcc.
```

## pkg-cfg/crosslinux-libc-devel/Kconfig
```kconfig
if BLD_GCC_4p7p3

config BLD_CROSSLINUX_LIBC_DEVEL
	bool
	default y
	prompt "libc-devel -- from the cross-tool chain."
	---help---
	  You must have libc-devel if you want to develop code with gcc.  This
	  package has the /usr/include header files and the C run-time start
	  and end files in /usr/lib.

config FORCE_LIBC_DEVEL
	def_bool y
	select BLD_CROSSLINUX_LIBC_DEVEL

endif
```

## pkg-cfg/crosslinux-libc/Kconfig
```kconfig
config BLD_CROSSLINUX_LIBC
	bool
	default y
	prompt "libc -- from the cross-tool chain."
	---help---
	  You must have a libc.  This comes from the cross-tool chain.

config FORCE_LIBC
	def_bool y
	select BLD_CROSSLINUX_LIBC
```

## pkg-cfg/dropbear-2014.63/Kconfig
```kconfig
config BLD_DROPBEAR_2014p63
	bool
	default y
	prompt "Build dropbear-2014.63"
	---help---
	  Select this option to cross-build dropbear.  Dropbear is a small
	  SSH v2 server and client package.  It includes SCP for copying files
	  between hosts.
```

## pkg-cfg/dtach-0.8/Kconfig
```kconfig
config BLD_DTACH_0p8
	bool
	default n
	prompt "Build dtach-0.8"
	---help---
	  Select this option to cross-build dtach.  dtach is a program that
	  emulates the detach feature of screen, , allowing you to run a
	  program in an environment that is protected from the controlling
	  terminal and attach to it later.
```

## pkg-cfg/dvtm-0.11/Kconfig
```kconfig
config BLD_DVTM_0p11
	bool
	default n
	prompt "Build dvtm-0.11"
	---help---
	  Select this option to cross-build dvtm.  dvtm is a console window
	  manager; it make easier work with multiple console based programs.
```

## pkg-cfg/e2fsprogs-1.42.9/Kconfig
```kconfig
config BLD_E2FSPROGS_1p42p9
	bool
	default y
	prompt "Build e2fsprogs-1.42.9"
	---help---
	  Select this option to cross-build e2fsprogs.  This has utilities for
	  handling the ext2 file system.  It also supports the ext3 and ext4
	  journaling file systems.

config E2FSPROGS_HAS_BLKID
	bool
	default y if ! HAVE_UTIL_LINUX
	default n if HAVE_UTIL_LINUX = y

config E2FSPROGS_HAS_FINDFS
	bool
	default y if ! HAVE_UTIL_LINUX
	default n if HAVE_UTIL_LINUX = y
```

## pkg-cfg/gcc-4.7.3/Kconfig
```kconfig
config BLD_GCC_4p7p3
	bool
	default n
	prompt "Build gcc-4.7.3"
	---help---
	  Select this option to cross-build gcc.  Yeah!
```

## pkg-cfg/gmp-5.0.5/Kconfig
```kconfig
config BLD_GMP_5p0p5
	bool
	default n
	prompt "Build gmp-5.0.5"
	---help---
	  Select this option to cross-build gmp, a support library mainly for
	  gcc.
```

## pkg-cfg/haserl-0.9.32/Kconfig
```kconfig
config BLD_HASERL_0p9p32
	bool
	default n
	prompt "Build haserl-0.9.32"
	---help---
	  Select this option to cross-build haserl.  haserl is a tiny (<30K)
	  cgi wrapper that uses a UNIX shell or a Lua VM to provide PHP-like
	  scripting for dynamic web content.  It transparently parses form
	  data, including mime-formatted file uploads.
```

## pkg-cfg/iptables-1.4.18/Kconfig
```kconfig
config BLD_IPTABLES_1p4p18
	bool
	default y
	prompt "Build iptables-1.4.18"
	---help---
	  Select this option to cross-build iptables.  iptables is used to make
	  a the network firewall.
```

## pkg-cfg/kmod-16/Kconfig
```kconfig
config BLD_KMOD_16
	bool
	default n
	prompt "Build kmod-16"
	---help---
	  Select this option to cross-build kmod.  This package has libraries
	  and utilities for loading kernel modules, such as 'insmod' and 'lsmod.
```

## pkg-cfg/lilo-24.0/Kconfig
```kconfig
config BLD_LILO_24p0
	bool
	default y
	prompt "Build lilo-24.0"
	---help---
	  Select this option to cross-build lilo, the LInux LOader.
```

## pkg-cfg/lua-5.2.3/Kconfig
```kconfig
config BLD_LUA_5p2p3
	bool
	default n
	prompt "Build lua-5.2.3"
	---help---
	  Select this option to cross-build lua.  Lua is a powerful, fast,
	  lightweight, embeddable scripting language.
```

## pkg-cfg/lynx-2.8.8/Kconfig
```kconfig
config BLD_LYNX_2p8p8
	bool
	default n
	prompt "Build lynx-2.8.8"
	---help---
	  Select this option to cross-build lynx.  lynx is a text web browser.
```

## pkg-cfg/make-4.0/Kconfig
```kconfig
config BLD_MAKE_4p0
	bool
	default n
	prompt "Build make-4.0"
	---help---
	  Select this option to cross-build make.
```

## pkg-cfg/mpc-1.0.1/Kconfig
```kconfig
config BLD_MPC_1p0p1
	bool
	default n
	prompt "Build mpc-1.0.1"
	---help---
	  Select this option to cross-build mpc, a support library mainly for
	  gcc.
```

## pkg-cfg/mpfr-3.1.1/Kconfig
```kconfig
config BLD_MPFR_3p1p1
	bool
	default n
	prompt "Build mpfr-3.1.1"
	---help---
	  Select this option to cross-build mpfr, a support library mainly for
	  gcc.
```

## pkg-cfg/nano-2.3.2/Kconfig
```kconfig
config BLD_NANO_2p3p2
	bool
	default n
	prompt "Build nano-2.3.2"
	---help---
	  Select this option to cross-build nano.  nano is a small editor.
```
