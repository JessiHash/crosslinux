## pkg-cfg/ntfs-3g-ntfsprogs-2014.2.15/Kconfig
```kconfig
config BLD_NTFS_3G_NTFSPROGS_2014p2p15
	bool
	default n
	prompt "Build ntfs-3g_ntfsprogs-2014.2.15"
	---help---
	  Select this option to cross-build Tuxera NTFS-3G+Ntfsprogs.
	  http://www.tuxera.com/community/ntfs-3g-download/
```

## pkg-cfg/ppl-0.11/Kconfig
```kconfig
config BLD_PPL_0p11
	bool
	default n
	prompt "Build ppl-0.11"
	---help---
	  Select this option to cross-build ppl, a support library mainly for
	  gcc.
```

## pkg-cfg/readline-6.3/Kconfig
```kconfig
config BLD_READLINE_6p3
	bool
	default n
	prompt "Build readline-6.3"
	---help---
	  Select this option to cross-build readline.  This makes the
	  dynamic and static libreadline and libhistory libraries; the header
	  files are also included.
```

## pkg-cfg/retawq-0.2.6c/Kconfig
```kconfig
config BLD_RETAWQ_0p2p6C
	bool
	default y
	prompt "Build retawq-0.2.6c"
	---help---
	  Select this option to cross-build retawq.  retawq is an interactive,
	  multi-threaded network client (web browser) for text terminals.

config RETAWQ_HAS_THREADING
	bool
	default n
	depends on BLD_RETAWQ_0p2p6C
	prompt "Build retawq-0.2.6c with threading"
	---help---
	  Select this option to cross-build retawq with threading.  You might
	  not want to use threading to minimize memory usage.
```

## pkg-cfg/thttpd-2.25b/Kconfig
```kconfig
config BLD_THTTPD_2p25B
	bool
	default n
	prompt "Build thttpd-2.25b"
	---help---
	  Select this option to cross-build thttpd, the tiny/turbo/throttling
	  HTTP server.
```

## pkg-cfg/tree-1.7.0/Kconfig
```kconfig
config BLD_TREE_1p7p0
	bool
	default n
	prompt "Build tree-1.7.0"
	---help---
	  Select this option to cross-build tree, a recursive directory and file
	  lister.
```

## pkg-cfg/ttylinux-utils-1.6/Kconfig
```kconfig
config BLD_TTYLINUX_UTILS_1p6
	bool
	default n
	prompt "Build ttylinux-utils-1.6"
	---help---
	  Select this option to include the ttylinux utils.  This includes the
	  ttylinux package manager 'pacman'.
```

## pkg-cfg/util-linux-2.24/Kconfig
```kconfig
config BLD_UTIL_LINUX_2p24
	bool
	default n
	prompt "Build util-linux-2.24"
	---help---
	  Select this option to cross-build util-linux.  Only these programs
	  will be built and installed:
	       lib/libblkid.so
	       sbin/blkid
	       sbin/findfs
	       sbin/losetup
	       usr/include/blkid/blkid.h
	       usr/lib/libblkid.a
	       usr/lib/libblkid.so
	       usr/lib/pkgconfig/blkid.pc

config HAVE_UTIL_LINUX
	bool
	default y if BLD_UTIL_LINUX_2p24 = y
	default n if ! BLD_UTIL_LINUX_2p24
```
